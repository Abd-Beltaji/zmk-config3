## boards/shields/mysplit/Kconfig.shield
```kconfig
config SHIELD_MYSPLIT_LEFT
    def_bool $(shields_list_contains,mysplit_left)

config SHIELD_MYSPLIT_RIGHT
    def_bool $(shields_list_contains,mysplit_right)

config SHIELD_MYSPLIT_DONGLE
    def_bool $(shields_list_contains,mysplit_dongle)
```

## config/boards/shields/mysplit/Kconfig.defconfig
```kconfig
if SHIELD_MYSPLIT_LEFT

config ZMK_KEYBOARD_NAME
    default "My Split"

config ZMK_SPLIT_BLE_CENTRAL_PERIPHERALS
    default 1

endif

if SHIELD_MYSPLIT_DONGLE

config ZMK_USB
    default y

config ZMK_BLE
    default y

endif

if SHIELD_MYSPLIT_LEFT || SHIELD_MYSPLIT_RIGHT || SHIELD_MYSPLIT_DONGLE

config ZMK_SPLIT
    default y

config ZMK_SPLIT_BLE
    default y

endif
```
